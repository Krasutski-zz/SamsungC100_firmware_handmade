/*
 * grafics.c
 *
 *  Created on: 10.08.2011
 *      Author: Denis
 */

#include "platform/RTC.h"

  const char font5x8[256][5] = {
  {0x00, 0x00, 0x00, 0x00, 0x00},// 00
  {0x00, 0x00, 0x5F, 0x00, 0x00},// 01
  {0x00, 0x07, 0x00, 0x07, 0x00},// 02
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  {0x48, 0x54, 0x34, 0x14, 0x7C} // FF СЏ
} ;

volatile unsigned short colorFt=0x7e0,colorBg=0;


static void font_printChar(const u8 x,const u8 y,const u8 asscii)
{
	char ShiftBit=1;

	LCD_base=0x43;
	LCD_base=0x10+x;
	LCD_base=0x14+x;
	LCD_base=0x42;
	LCD_base=y;
	LCD_base=y+7;

	do
	{
		if( font5x8[asscii][0] & ShiftBit ){LCD_data=colorFt;}else{LCD_data=colorBg;}
		if( font5x8[asscii][1] & ShiftBit ){LCD_data=colorFt;}else{LCD_data=colorBg;}
		if( font5x8[asscii][2] & ShiftBit ){LCD_data=colorFt;}else{LCD_data=colorBg;}
		if( font5x8[asscii][3] & ShiftBit ){LCD_data=colorFt;}else{LCD_data=colorBg;}
		if( font5x8[asscii][4] & ShiftBit ){LCD_data=colorFt;}else{LCD_data=colorBg;}
		ShiftBit<<=1;
	}while(ShiftBit!=0);
}

void font_printlcd(unsigned char *text,char num_row)
{
	char x=0;
	do
	{
		font_printChar(x,num_row*8,*text);
		x+=6;
		text++;
	}while(*text!=0);

}

void font_SetColor(unsigned short font,unsigned short background)
{
	colorFt=font;
	colorBg=background;
}

void font_printDec(unsigned char x,unsigned char y,unsigned char val)
{
	unsigned ret=0;

	ret=val/100+0x30;
	if(ret>0x30)
		{
			font_printChar(x,y,ret);
			x+=6;
			ret=val%100;
		}

	ret=val/10+0x30;
	font_printChar(x,y,ret);
	ret=val%10+0x30;
	font_printChar(x+6,y,ret);

}

void font_printHex(unsigned char x,unsigned char y,unsigned char val)
{
	unsigned ret=0;


	switch(val>>4)
	{
		case 0x0: {ret=0x30;break;}
		case 0x1: {ret=0x31;break;}
		case 0x2: {ret=0x32;break;}
		case 0x3: {ret=0x33;break;}
		case 0x4: {ret=0x34;break;}
		case 0x5: {ret=0x35;break;}
		case 0x6: {ret=0x36;break;}
		case 0x7: {ret=0x37;break;}
		case 0x8: {ret=0x38;break;}
		case 0x9: {ret=0x39;break;}
		case 0xA: {ret=0x41;break;}
		case 0xB: {ret=0x42;break;}
		case 0xC: {ret=0x43;break;}
		case 0xD: {ret=0x44;break;}
		case 0xE: {ret=0x45;break;}
		case 0xF: {ret=0x46;break;}
	}
	font_printChar(x,y,ret);

	switch(val&0x0f)
	{
		case 0x0: {ret=0x30;break;}
		case 0x1: {ret=0x31;break;}
		case 0x2: {ret=0x32;break;}
		case 0x3: {ret=0x33;break;}
		case 0x4: {ret=0x34;break;}
		case 0x5: {ret=0x35;break;}
		case 0x6: {ret=0x36;break;}
		case 0x7: {ret=0x37;break;}
		case 0x8: {ret=0x38;break;}
		case 0x9: {ret=0x39;break;}
		case 0xA: {ret=0x41;break;}
		case 0xB: {ret=0x42;break;}
		case 0xC: {ret=0x43;break;}
		case 0xD: {ret=0x44;break;}
		case 0xE: {ret=0x45;break;}
		case 0xF: {ret=0x46;break;}
	}
	font_printChar(x+6,y,ret);
}


void font_printTime(char x,char y)
{
	RTC_Time_t time;

	GetTime(&time);

	font_printDec(x,y,time.hours&0x7f);
	font_printChar(x+2*6,y,':');
	font_printDec(x+3*6,y,time.min&0x7f);
	font_printChar(x+5*6,y,':');
	font_printDec(x+6*6,y,time.sec&0x7f);
}





